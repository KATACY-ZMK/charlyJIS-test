## boards/shields/charlyJIStest/Kconfig.defconfig
```kconfig
if SHIELD_CHARLY_T_J_R

config ZMK_KEYBOARD_NAME
    default "charlyJIStest"

config ZMK_SPLIT_ROLE_CENTRAL
    default y

endif

if SHIELD_CHARLY_T_J_L|| SHIELD_CHARLY_T_J_R

config ZMK_SPLIT
    default y


endif

if SHIELD_CHARLY_T_J_R

# Other settings

config ZMK_POINTING
    default y

# Assuming pointing device uses SPI
config SPI
    default y

endif
```

## boards/shields/charlyJIStest/Kconfig.shield
```kconfig
config SHIELD_CHARLY_T_J_R
    def_bool $(shields_list_contains,charly-t_j_r)

config SHIELD_CHARLY_T_J_L
    def_bool $(shields_list_contains,charly-t_j_l)
```
